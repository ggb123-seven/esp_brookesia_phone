## main/Kconfig.projbuild
```kconfig
menu "Example Configurations"
    config EXAMPLE_ENABLE_SD_CARD
        bool "Enable SD Card"
        default n
        help 
            Enabling this option will initialize the SD card, so the SD card needs to be inserted into the slot. Additionally, if using the Video Player example, an MJPEG format video must be saved on the SD card.

    config EXAMPLE_ENABLE_APP_CALCULATOR
        bool "Enable Calculator App"
        default n
        help
            Enabling this option will compile and install the Calculator app.
            Keep it disabled to reduce the factory app partition usage.

    config EXAMPLE_ENABLE_APP_GAME_2048
        bool "Enable 2048 Game App"
        default n
        help
            Enabling this option will compile and install the 2048 game app.
            Keep it disabled to reduce the factory app partition usage.

    config EXAMPLE_ENABLE_APP_MUSIC_PLAYER
        bool "Enable Music Player App"
        default n
        help
            Enabling this option will compile and install the Music Player app.
            Keep it disabled when the launcher should only show classroom apps.

    config EXAMPLE_ENABLE_APP_VIDEO_PLAYER
        bool "Enable Video Player App"
        depends on EXAMPLE_ENABLE_SD_CARD
        default n
        help
            Enabling this option will compile and install the Video Player app.
            It also requires an inserted SD card with an MJPEG video file.

    config EXAMPLE_ENABLE_APP_FINGERPRINT
        bool "Enable Fingerprint App"
        default y
        help
            Enabling this option will compile and install the AS608 fingerprint app.
            Disable it before enabling the temporary AS608 validation task.

    config EXAMPLE_ENABLE_APP_ENVIRONMENT_MONITOR
        bool "Enable Environment Monitor App"
        default y
        help
            Enabling this option will compile and install the Environment Monitor app.
            The app displays DHT11 and MQ-2 service snapshots on the device screen.

    config EXAMPLE_ENABLE_APP_CLASSROOM_SCHEDULE
        bool "Enable Classroom Schedule App"
        default y
        help
            Enabling this option will compile and install the classroom schedule app.
            The app fetches today's schedule from a user-provided HTTP JSON endpoint.

    if EXAMPLE_ENABLE_APP_CLASSROOM_SCHEDULE
        config EXAMPLE_CLASSROOM_SCHEDULE_SERVER_HOST
            string "Classroom schedule server host"
            default "192.168.1.100"
            help
                Server IP or host name. Do not include http:// or a path.

        config EXAMPLE_CLASSROOM_SCHEDULE_SERVER_PORT
            int "Classroom schedule server port"
            range 1 65535
            default 8080
            help
                HTTP port used by the classroom schedule server.

        config EXAMPLE_CLASSROOM_SCHEDULE_API_PATH
            string "Classroom schedule API path"
            default "/classroom-schedule/today"
            help
                Path for the schedule JSON endpoint. The app appends classroom,
                date, and token query parameters.

        config EXAMPLE_CLASSROOM_SCHEDULE_BUILDINGS_PATH
            string "Classroom schedule buildings API path"
            default "/classroom-schedule/buildings"
            help
                Path for the server-discovered EAMS building catalog.

        config EXAMPLE_CLASSROOM_SCHEDULE_ROOMS_PATH
            string "Classroom schedule rooms API path"
            default "/classroom-schedule/rooms"
            help
                Path for the selected building's complete room catalog.

        config EXAMPLE_CLASSROOM_SCHEDULE_TOKEN
            string "Classroom schedule API token"
            default "change-me"
            help
                Shared access token sent to the schedule server. Replace this in
                menuconfig or sdkconfig before real deployment. Do not commit a
                real token.

        config EXAMPLE_CLASSROOM_SCHEDULE_REFRESH_MS
            int "Classroom schedule auto refresh period in milliseconds"
            range 60000 3600000
            default 600000
            help
                Auto refresh period while the app is open. Default is 10 minutes.

        config EXAMPLE_CLASSROOM_SCHEDULE_REQUEST_TIMEOUT_MS
            int "Classroom schedule request timeout in milliseconds"
            range 1000 30000
            default 30000
            help
                HTTP request timeout for one schedule refresh. The real EAMS
                provider may need to scan multiple syllabus pages on a cache miss.
    endif

    config EXAMPLE_ENABLE_PARENT_CALL_ALERT_SERVICE
        bool "Enable parent call alert service"
        depends on EXAMPLE_ENABLE_APP_ENVIRONMENT_MONITOR && EXAMPLE_ENABLE_MQ2_SERVICE
        default y
        help
            Enabling this option starts the parent call alert service.
            Keep Mock selected until the real phone module, SIM, antenna,
            power supply, and UART wiring are ready.

    if EXAMPLE_ENABLE_PARENT_CALL_ALERT_SERVICE
        config EXAMPLE_PARENT_CALL_ALERT_SERVER_HOST
            string "Parent call alert server host"
            default "10.34.88.246"
            help
                Server IP or host name. Do not include http:// or a path.

        config EXAMPLE_PARENT_CALL_ALERT_SERVER_PORT
            int "Parent call alert server port"
            range 1 65535
            default 8080
            help
                HTTP port used by the parent call alert middleware.

        config EXAMPLE_PARENT_CALL_ALERT_API_PATH
            string "Parent call alert API path"
            default "/parent-call-alert/trigger"
            help
                HTTP POST path for alert events.

        config EXAMPLE_PARENT_CALL_ALERT_TOKEN
            string "Parent call alert API token"
            default "change-me"
            help
                Shared access token sent in X-Alert-Token. Replace this in
                menuconfig or sdkconfig before real deployment. Do not commit a
                real token.

        choice EXAMPLE_PARENT_CALL_ALERT_TRANSPORT
            prompt "Parent call alert transport"
            default EXAMPLE_PARENT_CALL_ALERT_TRANSPORT_MOCK
            help
                Select MOCK until the real phone module or cloud voice middleware
                is connected. HTTP sends POST requests to the configured endpoint.
                Air780E AT sends ATD/ATH over UART and can place real calls when
                the module/SIM/operator support voice service.

            config EXAMPLE_PARENT_CALL_ALERT_TRANSPORT_MOCK
                bool "Mock/demo only"
                help
                    Record and display a simulated alert without network or phone dialing.

            config EXAMPLE_PARENT_CALL_ALERT_TRANSPORT_HTTP
                bool "HTTP middleware"
                help
                    Send alert events to the configured HTTP middleware.

            config EXAMPLE_PARENT_CALL_ALERT_TRANSPORT_AIR780E_AT
                bool "Air780E AT voice call"
                help
                    Send AT commands to an Air780E/Air780EHV-compatible module over UART.
                    This mode sends ATD<number>; and ATH, so only enable it after
                    confirming the module firmware, SIM card, antenna, and power rail
                    support real voice calls. Do not use an IoT-only SIM card.
        endchoice

        config EXAMPLE_PARENT_CALL_ALERT_AIR780E_PHONE_NUMBER
            string "Air780E parent phone number"
            default ""
            help
                Parent phone number used only by Air780E AT transport. Keep this
                empty in committed defaults and set it locally before real dialing.
                Digits are allowed, with an optional leading +.

        config EXAMPLE_PARENT_CALL_ALERT_AIR780E_UART_NUM
            int "Air780E UART port"
            range 1 5
            default 2
            help
                UART0 is reserved for the console. Avoid UART1 when AS608 is enabled.

        config EXAMPLE_PARENT_CALL_ALERT_AIR780E_TX_GPIO
            int "Air780E UART TX GPIO"
            range 0 54
            default 34
            help
                ESP32-P4 GPIO connected to Air780E RX. The default avoids the current
                ESP-hosted SDIO Wi-Fi pins, AS608, DHT11, and MQ-2 defaults, but must
                be changed to match the actual wiring.

        config EXAMPLE_PARENT_CALL_ALERT_AIR780E_RX_GPIO
            int "Air780E UART RX GPIO"
            range 0 54
            default 35
            help
                ESP32-P4 GPIO connected to Air780E TX. Change this to match the
                actual wiring before enabling Air780E AT mode.

        config EXAMPLE_PARENT_CALL_ALERT_AIR780E_BAUD_RATE
            int "Air780E UART baud rate"
            default 115200
            help
                Common Air780E AT examples use 115200 bps.

        config EXAMPLE_PARENT_CALL_ALERT_AIR780E_COMMAND_TIMEOUT_MS
            int "Air780E AT command timeout in milliseconds"
            range 1000 30000
            default 8000
            help
                Timeout for one Air780E AT command response.

        config EXAMPLE_PARENT_CALL_ALERT_AIR780E_CALL_HOLD_MS
            int "Air780E call hold time in milliseconds"
            range 0 120000
            default 15000
            help
                Time to keep the call active after ATD is accepted before sending ATH.

        config EXAMPLE_PARENT_CALL_ALERT_AIR780E_SELF_TEST_ON_BOOT
            bool "Run Air780E AT self-test on boot"
            default n
            help
                When Air780E AT transport is selected, send only AT on boot to verify
                UART communication. This does not dial the phone number.

        config EXAMPLE_PARENT_CALL_ALERT_COOLDOWN_MS
            int "Parent call alert cooldown in milliseconds"
            range 0 3600000
            default 300000
            help
                Cooldown after one successful alert request. Default is 5 minutes.

        config EXAMPLE_PARENT_CALL_ALERT_REQUEST_TIMEOUT_MS
            int "Parent call alert request timeout in milliseconds"
            range 1000 30000
            default 8000
            help
                HTTP request timeout for one alert trigger.

        config EXAMPLE_PARENT_CALL_ALERT_TASK_STACK_SIZE
            int "Parent call alert task stack size"
            range 4096 16384
            default 6144
            help
                Stack size for the alert HTTP worker task.

        config EXAMPLE_PARENT_CALL_ALERT_TASK_PRIORITY
            int "Parent call alert task priority"
            range 1 10
            default 5
            help
                FreeRTOS priority for the alert HTTP worker task.

        config EXAMPLE_PARENT_CALL_ALERT_QUEUE_LENGTH
            int "Parent call alert queue length"
            range 1 16
            default 4
            help
                Maximum pending alert events waiting for the worker task.
    endif

    config EXAMPLE_ENABLE_AS608_VALIDATION
        bool "Enable AS608 hardware validation task"
        depends on !EXAMPLE_ENABLE_APP_FINGERPRINT
        default n
        help
            Enabling this option starts a serial-log AS608 validation task at boot.
            Keep it disabled outside temporary fingerprint hardware validation.
            Disable the Fingerprint app first because both paths use the same AS608 service.

    config EXAMPLE_ENABLE_DHT11_SERVICE
        bool "Enable DHT11 temperature and humidity service"
        default y
        help
            Enabling this option starts the DHT11 periodic sampling service at boot.
            The first version only logs samples and exposes a snapshot query API.

    if EXAMPLE_ENABLE_DHT11_SERVICE
        config EXAMPLE_DHT11_DATA_GPIO
            int "DHT11 DATA GPIO"
            range 0 54
            default 32
            help
                ESP32-P4 GPIO connected to DHT11 DATA. Use an external 4.7k-10k pull-up to 3.3V.

        config EXAMPLE_DHT11_SAMPLE_PERIOD_MS
            int "DHT11 sample period in milliseconds"
            range 2000 60000
            default 2000
            help
                DHT11 should not be sampled faster than once every 2 seconds.

        config EXAMPLE_DHT11_MAX_CONSECUTIVE_FAILURES
            int "DHT11 consecutive failure threshold"
            range 1 20
            default 3
            help
                Log an error after this many consecutive sample failures.

        config EXAMPLE_DHT11_TASK_STACK_SIZE
            int "DHT11 task stack size"
            range 2048 8192
            default 3072
            help
                Stack size for the DHT11 periodic sampling task.

        config EXAMPLE_DHT11_TASK_PRIORITY
            int "DHT11 task priority"
            range 1 10
            default 4
            help
                FreeRTOS priority for the DHT11 periodic sampling task.
    endif

    config EXAMPLE_ENABLE_MQ2_SERVICE
        bool "Enable MQ-2 gas alarm service"
        default y
        help
            Enabling this option starts the MQ-2 digital alarm sampling service at boot.
            The first version reads the module DO threshold output only; AO analog
            sampling is reserved for a later calibrated extension.

    if EXAMPLE_ENABLE_MQ2_SERVICE
        config EXAMPLE_MQ2_DO_GPIO
            int "MQ-2 DO GPIO"
            range 0 54
            default 33
            help
                ESP32-P4 GPIO connected to MQ-2 DO. Confirm the module output level
                is safe for the ESP32-P4 input before wiring.

        config EXAMPLE_MQ2_ALARM_LEVEL
            int "MQ-2 alarm active level"
            range 0 1
            default 0
            help
                Digital level treated as alarm. Many MQ-2 modules drive DO low when
                the comparator threshold is exceeded, but module boards can differ.

        config EXAMPLE_MQ2_SAMPLE_PERIOD_MS
            int "MQ-2 sample period in milliseconds"
            range 100 60000
            default 500
            help
                Period for reading the MQ-2 DO level.

        config EXAMPLE_MQ2_WARMUP_MS
            int "MQ-2 warmup period in milliseconds"
            range 0 600000
            default 30000
            help
                Ignore alarm output during sensor warmup. MQ-2 sensors need a warmup
                period after power-on, and production deployments may need a longer value.

        config EXAMPLE_MQ2_CONFIRM_SAMPLES
            int "MQ-2 debounce confirmation samples"
            range 1 100
            default 3
            help
                Number of consecutive samples required before entering or leaving alarm state.

        config EXAMPLE_MQ2_TASK_STACK_SIZE
            int "MQ-2 task stack size"
            range 2048 8192
            default 3072
            help
                Stack size for the MQ-2 periodic sampling task.

        config EXAMPLE_MQ2_TASK_PRIORITY
            int "MQ-2 task priority"
            range 1 10
            default 4
            help
                FreeRTOS priority for the MQ-2 periodic sampling task.
    endif

    if EXAMPLE_ENABLE_AS608_VALIDATION || EXAMPLE_ENABLE_APP_FINGERPRINT
        config EXAMPLE_AS608_UART_NUM
            int "AS608 UART port"
            range 1 4
            default 1
            help
                UART0 is reserved for the console; use an available HP UART port for AS608.

        config EXAMPLE_AS608_TX_GPIO
            int "AS608 UART TX GPIO"
            default 14
            help
                ESP32-P4 GPIO connected to AS608 RX.

        config EXAMPLE_AS608_RX_GPIO
            int "AS608 UART RX GPIO"
            default 15
            help
                ESP32-P4 GPIO connected to AS608 TX.

        config EXAMPLE_AS608_BAUD_RATE
            int "AS608 UART baud rate"
            default 57600
            help
                AS608 factory default is commonly 57600 bps.

        config EXAMPLE_AS608_ADDRESS
            hex "AS608 device address"
            default 0xFFFFFFFF
            help
                AS608 factory default device address.

        config EXAMPLE_AS608_READ_TIMEOUT_MS
            int "AS608 UART read timeout in milliseconds"
            default 300
            help
                Per-read UART timeout used by the AS608 port adapter.
    endif

    if EXAMPLE_ENABLE_AS608_VALIDATION
        config EXAMPLE_AS608_VALIDATION_START_DELAY_MS
            int "AS608 validation start delay in milliseconds"
            default 5000
            help
                Delay before the validation task starts, allowing boot logs to settle.

        config EXAMPLE_AS608_VALIDATION_STEP_DELAY_MS
            int "AS608 validation step delay in milliseconds"
            default 3000
            help
                Delay before one-shot identify/match steps, giving the operator time to place or remove a finger.

        config EXAMPLE_AS608_VALIDATION_DELETE_ENROLLED
            bool "Delete enrolled template after validation"
            default n
            help
                Delete the template page enrolled by this validation run after all checks complete.
    endif
endmenu
```
